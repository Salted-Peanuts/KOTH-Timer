// ---- IMPORTANT: define CaptureState BEFORE Arduino auto-prototypes ----
#include <stdint.h>
enum CaptureState : uint8_t { ST_READY, ST_IDLE, ST_A, ST_B, ST_CONTESTED, ST_DONE };
// ----------------------------------------------------------------------

#include <WiFi.h>
#include <WebServer.h>
#include <WebSocketsServer.h>
#include <Preferences.h>
#include <TM1637Display.h>

/*
  KOTH Timer firmware v0.4.0
  Standalone release candidate
  Target board: Arduino Nano ESP32 (NORA-W106)

  Core game rules:
  - A team counts down only while exactly one team button is held.
  - Both buttons held = contested; neither team scores.
  - No buttons held = no scoring.
  - The match ends when either team's timer reaches zero.

  Standalone controls:
  - Local Wi-Fi admin UI at http://10.10.10.1/
  - Manual physical start: hold both team buttons for 5 seconds.
  - Referee time adjustment from the web UI.
  - Team identification mode while stopped.

  Battery protection:
  - 10k / 10k divider on A0.
  - Critical low-battery warning below 3.40 V.
  - A running match is frozen and saved to NVS at critical battery.
  - A saved match is restored paused after a battery swap/reboot.

  Notes:
  - The access point intentionally does NOT use captive-portal / automatic
    browser launching. Join "KOTH-Timer", then open http://10.10.10.1/.
  - Buzzer support is optional. The timer works normally with no buzzer fitted.\n  - If fitted, use a 3-pin active buzzer; patterns are rhythmic, not pitched.
*/

// ===== Wi-Fi AP =====
static const char* FIRMWARE_VERSION = "v0.4.0";
static const char* AP_SSID = "KOTH-Timer";
static const char* AP_PASS = ""; 
// Leave blank for open Wi-Fi.
// Optional: use "kothtimer" if you want a password later.
// Password must be at least 8 characters if used.

static const uint8_t AP_CHANNEL = 1;
static const uint8_t AP_MAX_CLIENTS = 3;
static const bool AP_HIDDEN = false;

static IPAddress AP_IP(10, 10, 10, 1);
static IPAddress AP_GATEWAY(10, 10, 10, 1);
static IPAddress AP_SUBNET(255, 255, 255, 0);

//// ===== Pins (Arduino Nano ESP32 labels) =====
// Buttons (to GND, INPUT_PULLUP)
static const int PIN_BTN_A   = D2;
static const int PIN_BTN_B   = D3;
static const int PIN_BTN_BAT = D4;

// Arcade button LEDs (GPIO -> resistor -> LED -> GND). HIGH = ON
static const int PIN_LED_A   = D5;
static const int PIN_LED_B   = D7;

// TM1637 (VCC -> VIN, GND -> GND)
static const int PIN_TM_CLK  = D8;
static const int PIN_TM_A1   = D9;
static const int PIN_TM_A2   = D10;
static const int PIN_TM_B1   = D11;
static const int PIN_TM_B2   = D6;   // moved off D12 (unreliable)

// Keyestudio 3-pin ACTIVE buzzer (VCC -> 3.3V, GND -> GND, SIG -> D13)
static const int PIN_BUZZER  = D13;

// Battery ADC divider midpoint
static const int PIN_BATT_ADC = A0;

// 5-bar battery indicator (common GND; GPIO HIGH = ON)
static const int PIN_BAR_RED    = A1;
static const int PIN_BAR_YELLOW = A2;
static const int PIN_BAR_G1     = A3;
static const int PIN_BAR_G2     = A4;
static const int PIN_BAR_G3     = A5;

//// ===== Battery calibration =====
// Final two-point calibration using ONLY the ESP32's own analogReadMilliVolts()
// value reported as "ba0" in /state.
//
// Both points were measured with the KOTH powered normally and the battery
// voltage measured under load.
//
// Measured points:
//   /state ba0 1.81V -> actual battery 3.39V
//   /state ba0 2.18V -> actual battery 4.09V
//
// Derived linear fit:
//   battery_V ≈ -0.034324 + (1.891892 * A0_V)
static const float CAL_A0_LOW    = 1.81f;
static const float CAL_BATT_LOW  = 3.39f;
static const float CAL_A0_HIGH   = 2.18f;
static const float CAL_BATT_HIGH = 4.09f;

// Optional final trim. Leave at defaults unless recalibrating against a meter.
static const float BATT_GAIN   = 1.000f;
static const float BATT_OFFSET = 0.000f;

//// ===== Battery smoothing knobs =====
// Stronger smoothing is useful because the calibrated A0 span is small.
static const float EMA_ALPHA = 0.05f;
static const uint32_t BATT_UPDATE_MS = 1000;
static const int BATT_SAMPLES = 16;

//// ===== Debounce =====
struct DebouncedButton {
  int pin;
  bool stable;      // HIGH not pressed, LOW pressed
  bool lastReading;
  uint32_t lastChangeMs;
};
static const uint32_t DEBOUNCE_MS = 25;

static DebouncedButton btnA  {PIN_BTN_A,   true, true, 0};
static DebouncedButton btnB  {PIN_BTN_B,   true, true, 0};
static DebouncedButton btnBt {PIN_BTN_BAT, true, true, 0};

static inline void readDebounced(DebouncedButton &b) {
  bool r = digitalRead(b.pin);
  if (r != b.lastReading) {
    b.lastReading = r;
    b.lastChangeMs = millis();
  }
  if (millis() - b.lastChangeMs > DEBOUNCE_MS) {
    b.stable = r;
  }
}
static inline bool isPressed(const DebouncedButton &b) { return b.stable == LOW; }

//// ===== State / Config =====
static Preferences prefs;

static uint32_t durationSec = 5 * 60;
static int32_t remainingA = 5 * 60;
static int32_t remainingB = 5 * 60;

static bool started = false;
static bool paused  = false;

// True when an emergency low-battery snapshot exists in non-volatile storage.
// It stays valid across battery removal / power loss until the admin resumes,
// resets, starts a new game, or otherwise deliberately clears it.
static bool recoverySnapshotValid = false;

static String colorA = "#ff3333";
static String colorB = "#3333ff";

static CaptureState captureState = ST_READY;

static uint32_t lastTickMs = 0;

// ===== Manual physical-button start =====
// When the match is stopped, holding BOTH team buttons for 5 seconds arms
// a non-blocking start countdown.
//
// Countdown sound (active buzzer):
//   short beep -> short beep -> LONG beep
//
// The match becomes LIVE at the START of the long beep.
// If both buttons are still held at that point the hill is simply contested,
// so neither team scores until only one team button remains held.
static const uint32_t MANUAL_START_HOLD_MS = 5000;
static const uint32_t MANUAL_START_GO_MS   = 1440; // start of long beep

static uint32_t bothButtonsHeldSinceMs = 0;
static bool manualStartSequenceActive = false;
static bool manualStartMatchStarted = false;
static uint32_t manualStartSequenceStartedMs = 0;

// Sub-second capture progress for each team.
// Keeping these separately means a partial scored second is preserved if a
// button is released, the hill becomes contested, or the match is paused.
static uint32_t partialMsA = 0;
static uint32_t partialMsB = 0;

//// ===== Identify mode =====
static bool identifyMode = false;
static uint32_t identifyUntilMs = 0;

//// ===== Battery / bargraph =====
static float battVolts = 0.0f;     // SMOOTHED
static float battVoltsRaw = 0.0f;  // instantaneous estimated battery voltage
static float battA0Volts = 0.0f;   // calibrated ESP32 A0 reading, volts
static int battPct = 0;

static bool barActive = false;
static uint32_t barOffAtMs = 0;
static const uint32_t BAR_SHOW_MS = 5000;

// Critical low-battery warning.
// Enter below 3.40V. Hysteresis prevents rapid on/off chatter around the threshold;
// warning clears only after two averaged readings rise above 3.45V.
static const float LOW_BATT_ENTER_V = 3.40f;
static const float LOW_BATT_EXIT_V  = 3.45f;
static const uint8_t LOW_BATT_CONFIRM_SAMPLES = 2;

static bool lowBatteryCritical = false;
static uint8_t lowBattLowCount = 0;
static uint8_t lowBattHighCount = 0;

//// ===== Displays =====
static TM1637Display dispA1(PIN_TM_CLK, PIN_TM_A1);
static TM1637Display dispA2(PIN_TM_CLK, PIN_TM_A2);
static TM1637Display dispB1(PIN_TM_CLK, PIN_TM_B1);
static TM1637Display dispB2(PIN_TM_CLK, PIN_TM_B2);

//// ===== Web =====
static WebServer server(80);
static WebSocketsServer ws(81);
static uint32_t lastBroadcastMs = 0;

//// ===== Active buzzer =====
// Keyestudio 3-pin ACTIVE buzzer on D13.
// Change to false only if the module turns on when D13 is LOW.
static const bool BUZZER_ACTIVE_HIGH = true;

// Short confirmation chirp for every real scored second.
static const uint32_t SCORE_CHIRP_MS = 35;

enum BuzzerMode : uint8_t { BUZZER_OFF, BUZZER_SCORE_CHIRP, BUZZER_VICTORY, BUZZER_LOW_BATT, BUZZER_MANUAL_START };

struct BuzzerPatternStep {
  bool on;
  uint16_t durationMs;
};

// Active buzzer victory pattern: BEEP - BEEP - BEEEEEEP
static const BuzzerPatternStep VICTORY_PATTERN[] = {
  {true,  100},
  {false, 100},
  {true,  100},
  {false, 150},
  {true,  700}
};
static const uint8_t VICTORY_PATTERN_COUNT =
  sizeof(VICTORY_PATTERN) / sizeof(VICTORY_PATTERN[0]);

// Manual physical start countdown:
//   BEEP ... BEEP ... BEEEEEEP
//
// The long beep begins 1440 ms after this pattern starts. That instant is GO.
static const BuzzerPatternStep MANUAL_START_PATTERN[] = {
  {true,  120},
  {false, 600},
  {true,  120},
  {false, 600},
  {true,  800}
};
static const uint8_t MANUAL_START_PATTERN_COUNT =
  sizeof(MANUAL_START_PATTERN) / sizeof(MANUAL_START_PATTERN[0]);

// Active buzzer has one fixed pitch, so the low-battery warning is a distinct
// rhythmic alarm rather than different musical notes:
//   BEEP-BEEP-BEEP ... pause ... repeat
static const BuzzerPatternStep LOW_BATT_PATTERN[] = {
  {true,   90},
  {false, 110},
  {true,   90},
  {false, 110},
  {true,   90},
  {false, 3500}
};
static const uint8_t LOW_BATT_PATTERN_COUNT =
  sizeof(LOW_BATT_PATTERN) / sizeof(LOW_BATT_PATTERN[0]);

static BuzzerMode buzzerMode = BUZZER_OFF;
static uint8_t buzzerPatternStep = 0;
static uint32_t buzzerDeadlineMs = 0;
static bool victoryPlayed = false;

static void buzzerSet(bool on) {
  const int activeLevel = BUZZER_ACTIVE_HIGH ? HIGH : LOW;
  const int inactiveLevel = BUZZER_ACTIVE_HIGH ? LOW : HIGH;
  digitalWrite(PIN_BUZZER, on ? activeLevel : inactiveLevel);
}

static void stopBuzzer() {
  buzzerSet(false);
  buzzerMode = BUZZER_OFF;
  buzzerPatternStep = 0;
  buzzerDeadlineMs = 0;
}

static void rearmVictorySound() {
  victoryPlayed = false;
  stopBuzzer();
}

static void startScoreChirp() {
  if (buzzerMode == BUZZER_VICTORY ||
      buzzerMode == BUZZER_LOW_BATT ||
      buzzerMode == BUZZER_MANUAL_START) return;
  buzzerSet(true);
  buzzerMode = BUZZER_SCORE_CHIRP;
  buzzerDeadlineMs = millis() + SCORE_CHIRP_MS;
}

static void startVictoryChime() {
  if (victoryPlayed) return;
  if (lowBatteryCritical || buzzerMode == BUZZER_LOW_BATT) return;
  victoryPlayed = true;
  buzzerMode = BUZZER_VICTORY;
  buzzerPatternStep = 0;
  buzzerSet(VICTORY_PATTERN[0].on);
  buzzerDeadlineMs = millis() + VICTORY_PATTERN[0].durationMs;
}

static void startManualStartCountdown() {
  if (lowBatteryCritical) return;

  // Don't allow another sound to trample the physical-start countdown.
  stopBuzzer();

  buzzerMode = BUZZER_MANUAL_START;
  buzzerPatternStep = 0;
  buzzerSet(MANUAL_START_PATTERN[0].on);
  buzzerDeadlineMs = millis() + MANUAL_START_PATTERN[0].durationMs;
}

static void startLowBatteryAlarm() {
  // Critical battery warning has priority over score chirps.
  if (buzzerMode == BUZZER_LOW_BATT) return;

  buzzerMode = BUZZER_LOW_BATT;
  buzzerPatternStep = 0;
  buzzerSet(LOW_BATT_PATTERN[0].on);
  buzzerDeadlineMs = millis() + LOW_BATT_PATTERN[0].durationMs;
}

static void updateBuzzer(uint32_t now) {
  // Start/stop the repeating critical-battery alarm as required.
  if (lowBatteryCritical) {
    if (buzzerMode != BUZZER_LOW_BATT && buzzerMode != BUZZER_VICTORY) {
      startLowBatteryAlarm();
    }
  } else if (buzzerMode == BUZZER_LOW_BATT) {
    stopBuzzer();
  }

  if (buzzerMode == BUZZER_OFF) return;
  if ((int32_t)(now - buzzerDeadlineMs) < 0) return;

  if (buzzerMode == BUZZER_SCORE_CHIRP) {
    stopBuzzer();
    return;
  }

  if (buzzerMode == BUZZER_LOW_BATT) {
    buzzerPatternStep++;
    if (buzzerPatternStep >= LOW_BATT_PATTERN_COUNT) {
      buzzerPatternStep = 0; // repeat alarm while battery remains critical
    }

    buzzerSet(LOW_BATT_PATTERN[buzzerPatternStep].on);
    buzzerDeadlineMs = now + LOW_BATT_PATTERN[buzzerPatternStep].durationMs;
    return;
  }

  if (buzzerMode == BUZZER_MANUAL_START) {
    buzzerPatternStep++;

    if (buzzerPatternStep >= MANUAL_START_PATTERN_COUNT) {
      stopBuzzer();
      manualStartSequenceActive = false;
      manualStartMatchStarted = false;
      return;
    }

    buzzerSet(MANUAL_START_PATTERN[buzzerPatternStep].on);
    buzzerDeadlineMs = now + MANUAL_START_PATTERN[buzzerPatternStep].durationMs;
    return;
  }

  // Victory pattern
  buzzerPatternStep++;
  if (buzzerPatternStep >= VICTORY_PATTERN_COUNT) {
    stopBuzzer();
    return;
  }

  buzzerSet(VICTORY_PATTERN[buzzerPatternStep].on);
  buzzerDeadlineMs = now + VICTORY_PATTERN[buzzerPatternStep].durationMs;
}

//// ===== Helpers =====
static String formatMMSS(int32_t s) {
  if (s < 0) s = 0;
  int32_t m = s / 60;
  int32_t r = s % 60;
  char buf[8];
  snprintf(buf, sizeof(buf), "%02ld:%02ld", (long)m, (long)r);
  return String(buf);
}
static uint16_t encodeMMSS(int32_t s) {
  if (s < 0) s = 0;
  int mm = (int)(s / 60);
  int ss = (int)(s % 60);
  return (uint16_t)(mm * 100 + ss);
}
static void resetTimers() {
  remainingA = (int32_t)durationSec;
  remainingB = (int32_t)durationSec;
  partialMsA = 0;
  partialMsB = 0;
}

static const int32_t MAX_REMAINING_SEC = (99 * 60) + 59; // TM1637 MM:SS practical max

static int32_t clampRemainingTime(int32_t seconds) {
  if (seconds < 0) return 0;
  if (seconds > MAX_REMAINING_SEC) return MAX_REMAINING_SEC;
  return seconds;
}

static void adjustTeamTime(const String &team, int32_t deltaSec) {
  if (team == "A") {
    remainingA = clampRemainingTime(remainingA + deltaSec);
    partialMsA = 0;
  } else if (team == "B") {
    remainingB = clampRemainingTime(remainingB + deltaSec);
    partialMsB = 0;
  }

  if (remainingA > 0 && remainingB > 0) {
    rearmVictorySound();
  }

  // Prevent an immediate time jump straight after a referee adjustment.
  lastTickMs = millis();

  updateDisplays();
}

static bool isHexDigitChar(char c) {
  return (c >= '0' && c <= '9') ||
         (c >= 'a' && c <= 'f') ||
         (c >= 'A' && c <= 'F');
}

static bool isValidHtmlColor(const String &value) {
  if (value.length() != 7 || value[0] != '#') return false;

  for (size_t i = 1; i < 7; i++) {
    if (!isHexDigitChar(value[i])) return false;
  }
  return true;
}

static void loadConfig() {
  prefs.begin("koth", true);
  durationSec = prefs.getUInt("dur", 5 * 60);
  colorA = prefs.getString("colA", "#ff3333");
  colorB = prefs.getString("colB", "#3333ff");
  prefs.end();

  if (!isValidHtmlColor(colorA)) colorA = "#ff3333";
  if (!isValidHtmlColor(colorB)) colorB = "#3333ff";

  if (durationSec < 60) durationSec = 60;
  if (durationSec > 60 * 60) durationSec = 60 * 60;
}
static void saveConfig() {
  prefs.begin("koth", false);
  prefs.putUInt("dur", durationSec);
  prefs.putString("colA", colorA);
  prefs.putString("colB", colorB);
  prefs.end();
}


// ===== Emergency low-battery game recovery =====
//
// This snapshot is intentionally written ONLY when the battery first crosses
// into the critical zone (or when a ref edits a recovered paused game).
// It is not written every second, avoiding unnecessary flash wear.
static void saveRecoveryState() {
  if (!started || remainingA <= 0 || remainingB <= 0) return;

  prefs.begin("koth", false);
  prefs.putInt("recA", remainingA);
  prefs.putInt("recB", remainingB);
  prefs.putUInt("recPA", partialMsA);
  prefs.putUInt("recPB", partialMsB);
  prefs.putBool("recValid", true);
  prefs.end();

  recoverySnapshotValid = true;
}

static void clearRecoveryState() {
  prefs.begin("koth", false);
  prefs.putBool("recValid", false);
  prefs.end();

  recoverySnapshotValid = false;
}

static bool loadRecoveryState() {
  prefs.begin("koth", true);
  bool valid = prefs.getBool("recValid", false);

  if (!valid) {
    prefs.end();
    recoverySnapshotValid = false;
    return false;
  }

  int32_t savedA = prefs.getInt("recA", -1);
  int32_t savedB = prefs.getInt("recB", -1);
  uint32_t savedPA = prefs.getUInt("recPA", 0);
  uint32_t savedPB = prefs.getUInt("recPB", 0);
  prefs.end();

  // Reject a corrupt/stale snapshot rather than restoring nonsense.
  if (savedA <= 0 || savedB <= 0 ||
      savedA > MAX_REMAINING_SEC || savedB > MAX_REMAINING_SEC ||
      savedPA >= 1000UL || savedPB >= 1000UL) {
    clearRecoveryState();
    return false;
  }

  remainingA = savedA;
  remainingB = savedB;
  partialMsA = savedPA;
  partialMsB = savedPB;

  // A recovered game ALWAYS boots frozen. The admin must explicitly Resume.
  started = true;
  paused = true;
  captureState = ST_IDLE;
  recoverySnapshotValid = true;
  return true;
}

static void freezeAndSaveForLowBattery() {
  // Only preserve an actual in-progress match.
  if (!started || remainingA <= 0 || remainingB <= 0) return;

  // Freeze scoring immediately before touching flash.
  paused = true;
  captureState = ST_IDLE;
  lastTickMs = millis();

  saveRecoveryState();
}

// Normal MM:SS display.
// Gameplay stays on the original whole-second timer format.
static void showTimeOn(TM1637Display &d, int32_t seconds, uint8_t separatorMask) {
  uint16_t v = encodeMMSS(seconds);
  bool leadingZero = (seconds >= 600); // original gameplay display behaviour
  d.showNumberDecEx(v, separatorMask, leadingZero);
}

// ===== Winner animation =====
//
// Each TM1637 is treated as its own self-contained celebration display.
// The six outside segments rotate around every digit like four little spinners.
//
// Sequence:
//   1) Three full spinner rotations
//   2) 00:00 blinks for ~2.4 seconds
//   3) Repeat until reset
//
// No 8888 flash is used.

static const uint8_t WIN_SPINNER_SEGMENTS[6] = {
  0x01, // A - top
  0x02, // B - upper right
  0x04, // C - lower right
  0x08, // D - bottom
  0x10, // E - lower left
  0x20  // F - upper left
};

static const uint32_t WIN_SPINNER_STEP_MS = 100;
static const uint8_t  WIN_SPINNER_ROTATIONS = 3;
static const uint32_t WIN_SPINNER_DURATION_MS =
  6UL * WIN_SPINNER_ROTATIONS * WIN_SPINNER_STEP_MS; // 1800 ms

static const uint32_t WIN_ZERO_BLINK_STEP_MS = 300;
static const uint8_t  WIN_ZERO_BLINK_PHASES = 8; // 4 on + 4 off
static const uint32_t WIN_ZERO_BLINK_DURATION_MS =
  WIN_ZERO_BLINK_STEP_MS * WIN_ZERO_BLINK_PHASES; // 2400 ms

static const uint32_t WIN_ANIM_CYCLE_MS =
  WIN_SPINNER_DURATION_MS + WIN_ZERO_BLINK_DURATION_MS;

static uint8_t victoryDisplayState = 0; // 0 none, 1 A, 2 B, 3 draw
static uint32_t victoryDisplayStartMs = 0;

static void showVictorySpinner(TM1637Display &d) {
  uint8_t step = (uint8_t)((millis() - victoryDisplayStartMs) / WIN_SPINNER_STEP_MS);
  step %= 6;

  uint8_t segs[4] = {
    WIN_SPINNER_SEGMENTS[step],
    WIN_SPINNER_SEGMENTS[step],
    WIN_SPINNER_SEGMENTS[step],
    WIN_SPINNER_SEGMENTS[step]
  };

  d.setSegments(segs);
}

static void showVictoryZeroBlink(TM1637Display &d, uint8_t separatorMask, uint32_t phaseElapsedMs) {
  uint8_t phase = (uint8_t)(phaseElapsedMs / WIN_ZERO_BLINK_STEP_MS);

  if ((phase % 2U) == 0U) {
    // Force all four digits so the winner clearly sees 00:00,
    // rather than the normal gameplay leading-zero suppression.
    d.showNumberDecEx(0, separatorMask, true);
  } else {
    d.clear();
  }
}

static void showVictoryAnimation(TM1637Display &d1, TM1637Display &d2,
                                 uint8_t separatorMask, uint32_t elapsedMs) {
  uint32_t cycleMs = elapsedMs % WIN_ANIM_CYCLE_MS;

  if (cycleMs < WIN_SPINNER_DURATION_MS) {
    showVictorySpinner(d1);
    showVictorySpinner(d2);
    return;
  }

  uint32_t blinkElapsed = cycleMs - WIN_SPINNER_DURATION_MS;
  showVictoryZeroBlink(d1, separatorMask, blinkElapsed);
  showVictoryZeroBlink(d2, separatorMask, blinkElapsed);
}

static void showTeamTime(TM1637Display &d1, TM1637Display &d2,
                         int32_t wholeSeconds,
                         uint8_t separatorMask) {
  showTimeOn(d1, wholeSeconds, separatorMask);
  showTimeOn(d2, wholeSeconds, separatorMask);
}

static void showLowBatteryText(TM1637Display &d, bool visible) {
  if (!visible) {
    d.clear();
    return;
  }

  // Raw 7-segment characters:
  // L = segments D+E+F = 0x38
  // O = same segments as digit 0 = 0x3F
  //
  // Bit 7 on the second digit drives the centre separator on these clock-style
  // TM1637 modules, giving the requested LO:LO appearance.
  uint8_t segs[4] = {
    0x38,        // L
    0x3F | 0x80, // O + centre separator
    0x38,        // L
    0x3F         // O
  };
  d.setSegments(segs);
}

static void updateDisplays() {
  const uint8_t separatorMask = 0b01000000;

  // Critical battery warning overrides all normal/winner display content.
  // All four TM1637 modules flash LO:LO together.
  if (lowBatteryCritical) {
    const bool lowBlinkOn = ((millis() / 450UL) % 2UL) == 0;
    showLowBatteryText(dispA1, lowBlinkOn);
    showLowBatteryText(dispA2, lowBlinkOn);
    showLowBatteryText(dispB1, lowBlinkOn);
    showLowBatteryText(dispB2, lowBlinkOn);
    return;
  }

  const bool aWon = (remainingA <= 0 && remainingB > 0);
  const bool bWon = (remainingB <= 0 && remainingA > 0);
  const bool draw = (remainingA <= 0 && remainingB <= 0);

  uint8_t newVictoryState = 0;
  if (draw) newVictoryState = 3;
  else if (aWon) newVictoryState = 1;
  else if (bWon) newVictoryState = 2;

  // Start the celebration from the beginning exactly when a winner appears.
  // If a referee adjustment removes the win condition, the animation rearms.
  if (newVictoryState != victoryDisplayState) {
    victoryDisplayState = newVictoryState;
    victoryDisplayStartMs = millis();
  }

  if (newVictoryState == 0) {
    showTeamTime(dispA1, dispA2, remainingA, separatorMask);    showTeamTime(dispB1, dispB2, remainingB, separatorMask);
    return;
  }

  uint32_t elapsedMs = millis() - victoryDisplayStartMs;

  if (aWon) {
    showVictoryAnimation(dispA1, dispA2, separatorMask, elapsedMs);
    showTeamTime(dispB1, dispB2, remainingB, separatorMask);
  } else if (bWon) {
    showTeamTime(dispA1, dispA2, remainingA, separatorMask);
    showVictoryAnimation(dispB1, dispB2, separatorMask, elapsedMs);
  } else {
    // Draw: both teams celebrate independently.
    showVictoryAnimation(dispA1, dispA2, separatorMask, elapsedMs);
    showVictoryAnimation(dispB1, dispB2, separatorMask, elapsedMs);
  }
}

// Winner string used by UI
static String winnerString() {
  // Match ends when either team reaches 0
  if (remainingA <= 0 && remainingB <= 0) return "DRAW";
  if (remainingA <= 0) return "TEAM_A";
  if (remainingB <= 0) return "TEAM_B";
  return "";
}

// Battery conversion using the ESP32's calibrated ADC millivolt reading.
//
// The two calibration points at the top of this file were taken from the
// firmware's own /state "ba0" value and matched against battery-terminal
// voltage measured under load. Keeping both points on the same ADC scale
// avoids mixing multimeter A0 readings with firmware ADC readings.
static float readBattVoltsInstant() {
  uint32_t sumMv = 0;

  for (int i = 0; i < BATT_SAMPLES; i++) {
    sumMv += analogReadMilliVolts(PIN_BATT_ADC);
    delay(2);
  }

  float v_adc = ((float)sumMv / (float)BATT_SAMPLES) / 1000.0f;
  battA0Volts = v_adc;

  const float slope =
    (CAL_BATT_HIGH - CAL_BATT_LOW) / (CAL_A0_HIGH - CAL_A0_LOW);

  float v_batt =
    CAL_BATT_LOW + ((v_adc - CAL_A0_LOW) * slope);

  v_batt = (v_batt * BATT_GAIN) + BATT_OFFSET;

  if (v_batt > 4.25f) v_batt = 4.25f;
  if (v_batt < 3.00f) v_batt = 3.00f;

  return v_batt;
}

static int voltsToPct(float v) {
  // Generic 1S Li-ion style battery gauge.
  // This is only an approximate state-of-charge style display.
  if (v >= 4.20f) return 100;
  if (v <= 3.30f) return 0;

  if (v >= 4.00f) return (int)(80 + (v - 4.00f) * (20.0f / 0.20f));
  if (v >= 3.85f) return (int)(55 + (v - 3.85f) * (25.0f / 0.15f));
  if (v >= 3.70f) return (int)(30 + (v - 3.70f) * (25.0f / 0.15f));
  if (v >= 3.50f) return (int)(10 + (v - 3.50f) * (20.0f / 0.20f));

  return (int)((v - 3.30f) * (10.0f / 0.20f));
}

static int voltsToBars(float v) {
  // Even 0.15 V steps across the useful steady-bar range.
  //
  // 1 bar  : 3.45 V to <3.60 V
  // 2 bars : 3.60 V to <3.75 V
  // 3 bars : 3.75 V to <3.90 V
  // 4 bars : 3.90 V to <4.05 V
  // 5 bars : 4.05 V and above
  //
  // Below 3.45 V, barShowBars() flashes the single red bar.
  if (v >= 4.05f) return 5;
  if (v >= 3.90f) return 4;
  if (v >= 3.75f) return 3;
  if (v >= 3.60f) return 2;
  if (v >= 3.45f) return 1;
  return 0;
}

// Bargraph outputs: HIGH=ON, LOW=OFF (your wiring)
static void barAllOff() {
  digitalWrite(PIN_BAR_RED, LOW);
  digitalWrite(PIN_BAR_YELLOW, LOW);
  digitalWrite(PIN_BAR_G1, LOW);
  digitalWrite(PIN_BAR_G2, LOW);
  digitalWrite(PIN_BAR_G3, LOW);
}
static void barShowBars(int bars, float v, uint32_t now) {
  // Below 3.45V, don't show an empty indicator. Flash the final red bar instead.
  if (v < 3.45f) {
    bool flashOn = ((now / 350UL) % 2UL) == 0;
    digitalWrite(PIN_BAR_RED,    flashOn ? HIGH : LOW);
    digitalWrite(PIN_BAR_YELLOW, LOW);
    digitalWrite(PIN_BAR_G1,     LOW);
    digitalWrite(PIN_BAR_G2,     LOW);
    digitalWrite(PIN_BAR_G3,     LOW);
    return;
  }

  digitalWrite(PIN_BAR_RED,    (bars >= 1) ? HIGH : LOW);
  digitalWrite(PIN_BAR_YELLOW, (bars >= 2) ? HIGH : LOW);
  digitalWrite(PIN_BAR_G1,     (bars >= 3) ? HIGH : LOW);
  digitalWrite(PIN_BAR_G2,     (bars >= 4) ? HIGH : LOW);
  digitalWrite(PIN_BAR_G3,     (bars >= 5) ? HIGH : LOW);
}
static void triggerBarShow() {
  barActive = true;
  barOffAtMs = millis() + BAR_SHOW_MS;
}

static void evaluateCaptureState(bool aHeld, bool bHeld) {
  if (remainingA <= 0 || remainingB <= 0) { captureState = ST_DONE; return; }
  if (!started) { captureState = ST_READY; return; }
  if (paused) { captureState = ST_IDLE; return; }

  if (aHeld && !bHeld) captureState = ST_A;
  else if (bHeld && !aHeld) captureState = ST_B;
  else if (aHeld && bHeld) captureState = ST_CONTESTED;
  else captureState = ST_IDLE;
}

static const char* stateToStr(CaptureState s) {
  switch (s) {
    case ST_READY:     return "READY";
    case ST_IDLE:      return "IDLE";
    case ST_A:         return "TEAM_A";
    case ST_B:         return "TEAM_B";
    case ST_CONTESTED: return "CONTESTED";
    case ST_DONE:      return "DONE";
    default:           return "IDLE";
  }
}

static String makeStateJson() {
  String win = winnerString();

  String json;
  json.reserve(256);
  json = "{";
  json += "\"a\":\"" + formatMMSS(remainingA) + "\",";
  json += "\"b\":\"" + formatMMSS(remainingB) + "\",";
  json += "\"status\":\"" + String(stateToStr(captureState)) + "\",";
  json += "\"started\":" + String(started ? "true" : "false") + ",";
  json += "\"paused\":" + String(paused ? "true" : "false") + ",";
  json += "\"lowBatt\":" + String(lowBatteryCritical ? "true" : "false") + ",";
  json += "\"recovery\":" + String(recoverySnapshotValid ? "true" : "false") + ",";
  json += "\"dur\":" + String(durationSec) + ",";
  json += "\"colA\":\"" + colorA + "\",";
  json += "\"colB\":\"" + colorB + "\",";
  json += "\"bv\":" + String(battVolts, 2) + ",";
  json += "\"ba0\":" + String(battA0Volts, 2) + ",";
  json += "\"bp\":" + String(battPct) + ",";
  json += "\"identify\":" + String(identifyMode ? "true" : "false") + ",";
  json += "\"winner\":\"" + win + "\"";
  json += "}";
  return json;
}

static void broadcastState() {
  String payload = makeStateJson(); // lvalue needed by WebSockets 2.7.2
  ws.broadcastTXT(payload);
}


//// ===== Embedded UI logos =====
// Stored as compact WebP byte arrays and served from local ESP32 routes.
// This avoids placing huge base64 strings inside the HTML raw string.
static const uint8_t SYDNEY_NERF_LOGO_WEBP[] PROGMEM = {
  0x52, 0x49, 0x46, 0x46, 0x5A, 0x3B, 0x00, 0x00, 0x57, 0x45, 0x42, 0x50, 0x56, 0x50, 0x38, 0x58,
  0x0A, 0x00, 0x00, 0x00, 0x10, 0x00, 0x00, 0x00, 0xDB, 0x00, 0x00, 0xDB, 0x00, 0x00, 0x41, 0x4C,
  0x50, 0x48, 0x5F, 0x05, 0x00, 0x00, 0x01, 0x0A, 0x4A, 0xB4, 0x6D, 0x1B, 0x9B, 0xAB, 0xAA, 0x3F,
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  0x00, 0x00
};
static const uint8_t PCBWAY_LOGO_WEBP[] PROGMEM = {
  0x52, 0x49, 0x46, 0x46, 0x7A, 0x1C, 0x00, 0x00, 0x57, 0x45, 0x42, 0x50, 0x56, 0x50, 0x38, 0x58,
  0x0A, 0x00, 0x00, 0x00, 0x10, 0x00, 0x00, 0x00, 0x2B, 0x01, 0x00, 0x66, 0x00, 0x00, 0x41, 0x4C,
  0x50, 0x48, 0xD8, 0x0D, 0x00, 0x00, 0x01, 0xF0, 0xC6, 0xFF, 0xFF, 0x2A, 0x25, 0xDB, 0xB6, 0xFD,
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  0x00, 0x00
};

//// ===== Embedded admin UI =====
static const char INDEX_HTML[] PROGMEM = R"HTML(
<!doctype html>
<html lang="en">
<head>
<meta charset="utf-8">
<meta name="viewport" content="width=device-width,initial-scale=1,viewport-fit=cover">
<meta name="theme-color" content="#101216">
<title>KOTH Timer</title>
<style>
:root{
  --bg:#101216;
  --panel:#1a1f28;
  --panel2:#232a36;
  --line:#343c4b;
  --text:#f5f7fb;
  --muted:#aab3c2;
  --a:#ff3333;
  --b:#3333ff;
  --aText:#fff;
  --bText:#fff;
  --blue:#4aa3ff;
  --green:#35d07f;
  --yellow:#f3c84b;
  --red:#ff6464;
}
*{box-sizing:border-box;-webkit-tap-highlight-color:transparent}
html,body{margin:0;min-height:100%;background:var(--bg);color:var(--text);font-family:system-ui,-apple-system,BlinkMacSystemFont,"Segoe UI",sans-serif}
body{padding:env(safe-area-inset-top) 0 env(safe-area-inset-bottom)}
.app{width:100%;max-width:520px;margin:0 auto;padding:12px 12px 24px}
.top{display:flex;align-items:center;justify-content:space-between;gap:10px;margin-bottom:10px}
h1{font-size:1.15rem;margin:0;font-weight:900;letter-spacing:.02em}
.pill{display:inline-flex;align-items:center;justify-content:center;gap:6px;border:1px solid var(--line);background:var(--panel);color:var(--muted);border-radius:999px;padding:7px 10px;font-size:.78rem;white-space:nowrap}
.pill.good{color:#b8ffd5;border-color:#23653f}
.pill.bad{color:#ffd0d0;border-color:#713434}
.statusBox{border:1px solid var(--line);background:linear-gradient(180deg,var(--panel2),var(--panel));border-radius:18px;padding:14px;margin-bottom:10px;text-align:center}
.statusMain{font-size:1.35rem;font-weight:950;line-height:1.1}
.statusSub{margin-top:5px;color:var(--muted);font-size:.9rem}
.teams{display:grid;gap:10px}
.teamCard{position:relative;overflow:hidden;border:1px solid var(--line);background:var(--panel);border-radius:20px;padding:12px 12px 14px}
.teamCard::before{content:"";position:absolute;left:0;top:0;bottom:0;width:8px;background:var(--team)}
.teamHead{display:flex;align-items:center;justify-content:space-between;margin-left:8px;gap:10px}
.teamName{font-size:1rem;font-weight:900}
.teamHint{font-size:.78rem;color:var(--muted)}
.time{font-variant-numeric:tabular-nums;text-align:center;font-size:4.15rem;line-height:1;font-weight:950;letter-spacing:-.055em;padding:4px 0 0}
.teamCard.active{box-shadow:0 0 0 2px var(--team) inset}
.teamCard.done{opacity:.72}
.grid2{display:grid;grid-template-columns:1fr 1fr;gap:10px}
.grid3{display:grid;grid-template-columns:1fr 1fr 1fr;gap:10px}
.section{border:1px solid var(--line);background:var(--panel);border-radius:20px;padding:12px;margin-top:10px}
.sectionTitle{font-size:1rem;font-weight:900;margin:0 0 10px}
button{width:100%;min-height:54px;border:0;border-radius:15px;background:#303848;color:var(--text);font-size:1rem;font-weight:900;padding:12px 10px;cursor:pointer}
button:active{transform:scale(.98);filter:brightness(1.13)}
button.primary{background:var(--blue);color:#061321}
button.good{background:var(--green);color:#04170c}
button.warn{background:var(--yellow);color:#1f1700}
button.bad{background:var(--red);color:#250000}
button.teamAdjustA{background:var(--a);color:var(--aText)}
button.teamAdjustB{background:var(--b);color:var(--bText)}
button.minus{filter:saturate(.75) brightness(.82)}
button.minus:active{filter:saturate(.75) brightness(1)}
button:disabled{opacity:.35;cursor:not-allowed;transform:none;filter:none}
label{display:block;color:var(--muted);font-size:.82rem;font-weight:750}
input[type=number]{width:100%;min-height:48px;margin-top:6px;border-radius:13px;border:1px solid var(--line);background:#10141b;color:var(--text);font-size:1.1rem;font-weight:850;padding:8px 10px}
input[type=color]{width:100%;height:48px;margin-top:6px;border:1px solid var(--line);border-radius:13px;background:#10141b;padding:4px}
.help{color:var(--muted);font-size:.82rem;line-height:1.35;margin-top:8px}
details{border:1px solid var(--line);background:var(--panel);border-radius:20px;padding:0;margin-top:10px;overflow:hidden}
summary{list-style:none;cursor:pointer;padding:14px 12px;font-size:1rem;font-weight:900}
summary::-webkit-details-marker{display:none}
.detailsInner{padding:0 12px 12px}
.sep{height:10px}
.miniStats{display:grid;grid-template-columns:1fr 1fr;gap:8px;margin-top:10px}
.stat{border:1px solid var(--line);background:#121720;border-radius:14px;padding:9px;text-align:center}
.statLabel{color:var(--muted);font-size:.72rem}
.statValue{font-size:.95rem;font-weight:900;margin-top:2px}
.logoStrip{display:flex;flex-direction:column;align-items:center;gap:14px;margin-top:18px;padding:6px 0 2px}
.logoCard{display:flex;align-items:center;justify-content:center;width:100%;padding:0;border:0;background:transparent}
.logoCard img{display:block;width:auto;height:auto;max-width:100%;object-fit:contain}
.logoCard img.logoSydney{width:min(74vw,300px)}
.logoCard img.logoPCBWay{width:min(78vw,300px)}
.footerNote{color:var(--muted);font-size:.74rem;line-height:1.3;text-align:center;margin-top:8px}
@media (max-width:380px){
  .app{padding-left:9px;padding-right:9px}
  .time{font-size:3.45rem}
  button{font-size:.92rem;min-height:50px}
  .statusMain{font-size:1.15rem}
}
</style>
</head>
<body>
<div class="app">
  <div class="top">
    <h1>KOTH Timer</h1>
    <span class="pill" id="connPill">Connecting</span>
  </div>

  <div class="statusBox">
    <div class="statusMain" id="statusMain">Loading...</div>
    <div class="statusSub" id="statusSub">Connect to KOTH-Timer and open 10.10.10.1</div>
  </div>

  <div class="teams">
    <div class="teamCard" id="cardA" style="--team:var(--a)">
      <div class="teamHead">
        <div>
          <div class="teamName" id="labelA">Team A</div>
          <div class="teamHint">Button A</div>
        </div>
        <span class="pill" id="stateA">Ready</span>
      </div>
      <div class="time" id="timeA">00:00</div>
    </div>

    <div class="teamCard" id="cardB" style="--team:var(--b)">
      <div class="teamHead">
        <div>
          <div class="teamName" id="labelB">Team B</div>
          <div class="teamHint">Button B</div>
        </div>
        <span class="pill" id="stateB">Ready</span>
      </div>
      <div class="time" id="timeB">00:00</div>
    </div>
  </div>

  <div class="section">
    <div class="sectionTitle">Game Control</div>
    <div class="grid2">
      <button class="good" id="startBtn" onclick="cmd('start')">Start</button>
      <button class="warn" id="pauseBtn" onclick="cmd('pause')">Pause</button>
      <button class="primary" id="resumeBtn" onclick="cmd('resume')">Resume</button>
      <button class="bad" id="resetBtn" onclick="cmd('reset')">Reset</button>
    </div>
    <div class="miniStats">
      <div class="stat">
        <div class="statLabel">Battery</div>
        <div class="statValue" id="batt">--</div>
      </div>
      <div class="stat">
        <div class="statLabel">Game State</div>
        <div class="statValue" id="stateText">--</div>
      </div>
    </div>
    <div class="help">Reset is only enabled when paused or after the match has finished.</div>
  </div>

  <div class="section">
    <div class="sectionTitle">Ref Time Fix</div>
    <label>Adjustment amount, seconds
      <input id="adjSecs" type="number" min="1" max="600" value="30" inputmode="numeric">
    </label>
    <div class="sep"></div>
    <div class="grid2">
      <button id="fixAPlus" class="teamAdjustA" onclick="adjustTime('A', getAdjustSeconds())">Red Team +</button>
      <button id="fixAMinus" class="teamAdjustA minus" onclick="adjustTime('A', -getAdjustSeconds())">Red Team −</button>
      <button id="fixBPlus" class="teamAdjustB" onclick="adjustTime('B', getAdjustSeconds())">Blue Team +</button>
      <button id="fixBMinus" class="teamAdjustB minus" onclick="adjustTime('B', -getAdjustSeconds())">Blue Team −</button>
    </div>
    <div class="sep"></div>
    <div class="grid3">
      <button onclick="quickSet(10)">10s</button>
      <button onclick="quickSet(30)">30s</button>
      <button onclick="quickSet(60)">60s</button>
    </div>
    <div class="help">Left buttons add time. Right buttons subtract time. Use this during gameplay if a ref needs to correct a mistake without resetting the match.</div>
  </div>

  <details>
    <summary>Match Setup</summary>
    <div class="detailsInner">
      <label>Duration, minutes
        <input id="mins" type="number" min="1" max="60" value="5" inputmode="numeric">
      </label>
      <div class="sep"></div>
      <button class="primary" onclick="applyDuration()">Apply Duration</button>

      <div class="sep"></div>
      <div class="grid2">
        <label>Team A colour
          <input id="colA" type="color" value="#ff3333">
        </label>
        <label>Team B colour
          <input id="colB" type="color" value="#3333ff">
        </label>
      </div>
      <div class="sep"></div>
      <button class="primary" onclick="applyColors()">Apply Colours</button>
      <div class="sep"></div>
      <button onclick="cmd('identify')">Identify Teams</button>
      <div class="help">Identify teams only works while the game is stopped.</div>
    </div>
  </details>

  <details>
    <summary>Connection Help</summary>
    <div class="detailsInner">
      <div class="help">
        Wi-Fi: <b>KOTH-Timer</b><br>
        Page: <b>http://10.10.10.1</b><br>
        Test: <b>http://10.10.10.1/ping</b><br><br>
        Automatic browser opening is intentionally disabled.<br>
        After joining the Wi-Fi, open <b>http://10.10.10.1</b> manually.<br><br>
        If your phone says no internet, choose stay connected or use without internet.
      </div>
    </div>
  </details>

  <div class="logoStrip">
    <div class="logoCard">
      <img class="logoSydney" src="/sydney-nerf.webp" alt="Sydney Nerf logo">
    </div>
    <div class="logoCard">
      <img class="logoPCBWay" src="/pcbway.webp" alt="PCBWay logo">
    </div>
  </div>
  <div class="footerNote">Proudly Open Source</div>
</div>

<script>
let ws = null;
let lastStateAt = 0;
let wsWanted = true;

// Prevent live state polling from overwriting a value while the referee edits it.
let minsDirty = false;
let colADirty = false;
let colBDirty = false;

const el = (id) => document.getElementById(id);

window.addEventListener("load", function(){
  el("mins").addEventListener("input", function(){ minsDirty = true; });
  el("colA").addEventListener("input", function(){ colADirty = true; });
  el("colB").addEventListener("input", function(){ colBDirty = true; });
});

function setConn(text, good){
  const p = el("connPill");
  p.textContent = text;
  p.className = "pill " + (good ? "good" : "bad");
}

function hexToRgb(hex){
  const h = (hex || "").replace("#","").trim();
  if(h.length !== 6) return null;
  const n = parseInt(h, 16);
  if(Number.isNaN(n)) return null;
  return {r:(n>>16)&255,g:(n>>8)&255,b:n&255};
}

function rgbToHsl(r,g,b){
  r/=255; g/=255; b/=255;
  const max=Math.max(r,g,b), min=Math.min(r,g,b);
  let h=0, s=0, l=(max+min)/2;
  const d=max-min;
  if(d){
    s=d/(1-Math.abs(2*l-1));
    if(max===r) h=((g-b)/d)%6;
    else if(max===g) h=(b-r)/d+2;
    else h=(r-g)/d+4;
    h*=60;
    if(h<0) h+=360;
  }
  return {h,s,l};
}

function teamName(hex){
  const rgb = hexToRgb(hex);
  if(!rgb) return "Team";
  const hsl = rgbToHsl(rgb.r,rgb.g,rgb.b);
  if(hsl.s < 0.18 || hsl.l < 0.12 || hsl.l > 0.92) return "Neutral Team";
  const h = hsl.h;
  if(h < 15 || h >= 345) return "Red Team";
  if(h < 45) return "Orange Team";
  if(h < 70) return "Yellow Team";
  if(h < 160) return "Green Team";
  if(h < 200) return "Cyan Team";
  if(h < 255) return "Blue Team";
  if(h < 300) return "Purple Team";
  return "Pink Team";
}

function contrastText(hex){
  const rgb = hexToRgb(hex);
  if(!rgb) return "#ffffff";
  // Perceived brightness. Black text is easier on bright yellow/green/orange.
  const brightness = (rgb.r * 299 + rgb.g * 587 + rgb.b * 114) / 1000;
  return brightness > 155 ? "#061018" : "#ffffff";
}

function setColours(a,b){
  document.documentElement.style.setProperty("--a", a);
  document.documentElement.style.setProperty("--b", b);
  document.documentElement.style.setProperty("--aText", contrastText(a));
  document.documentElement.style.setProperty("--bText", contrastText(b));
  const nameA = teamName(a);
  const nameB = teamName(b);

  el("labelA").textContent = nameA;
  el("labelB").textContent = nameB;

  // Ref time-fix buttons use the selected colour names for fast event use.
  el("fixAPlus").textContent = nameA + " +";
  el("fixAMinus").textContent = nameA + " −";
  el("fixBPlus").textContent = nameB + " +";
  el("fixBMinus").textContent = nameB + " −";
}

function updateCards(d){
  const a = el("cardA");
  const b = el("cardB");
  a.classList.remove("active","done");
  b.classList.remove("active","done");
  el("stateA").textContent = "Ready";
  el("stateB").textContent = "Ready";

  if(d.status === "TEAM_A"){
    a.classList.add("active");
    el("stateA").textContent = "Capturing";
    el("stateB").textContent = "Defending";
  } else if(d.status === "TEAM_B"){
    b.classList.add("active");
    el("stateA").textContent = "Defending";
    el("stateB").textContent = "Capturing";
  } else if(d.status === "CONTESTED"){
    a.classList.add("active");
    b.classList.add("active");
    el("stateA").textContent = "Contested";
    el("stateB").textContent = "Contested";
  } else if(d.status === "DONE"){
    a.classList.add("done");
    b.classList.add("done");
    el("stateA").textContent = "Done";
    el("stateB").textContent = "Done";
  }
}

function updateStatus(d){
  const nameA = el("labelA").textContent || "Team A";
  const nameB = el("labelB").textContent || "Team B";
  let main = "Ready";
  let sub = "Waiting for game start";

  if(d.lowBatt && d.started){
    main = "LOW BATTERY — GAME FROZEN";
    sub = "Call FREEZE, replace the battery, then Resume when ready";
  } else if(d.lowBatt){
    main = "LOW BATTERY";
    sub = "Replace the battery before starting a match";
  } else if(d.recovery && d.started && d.paused){
    main = "Game recovered — paused";
    sub = "Saved scores restored. Resume when all players are ready";
  } else if(d.identify){
    main = "Identifying teams";
    sub = "Displays and LEDs are flashing";
  } else if(d.winner === "TEAM_A"){
    main = nameA + " wins!";
    sub = "Match complete";
  } else if(d.winner === "TEAM_B"){
    main = nameB + " wins!";
    sub = "Match complete";
  } else if(d.winner === "DRAW"){
    main = "Draw!";
    sub = "Match complete";
  } else if(d.paused){
    main = "Paused";
    sub = "Ref controls are available";
  } else if(!d.started){
    main = "Ready";
    sub = "Press Start to begin";
  } else if(d.status === "TEAM_A"){
    main = nameA + " capturing";
    sub = "Only Button A is held";
  } else if(d.status === "TEAM_B"){
    main = nameB + " capturing";
    sub = "Only Button B is held";
  } else if(d.status === "CONTESTED"){
    main = "Contested";
    sub = "Both buttons are held — no score";
  } else {
    main = "No capture";
    sub = "Hold one team button to score";
  }

  el("statusMain").textContent = main;
  el("statusSub").textContent = sub;
}

function updateUI(d){
  lastStateAt = Date.now();

  if(typeof d.a === "string") el("timeA").textContent = d.a;
  if(typeof d.b === "string") el("timeB").textContent = d.b;

  if(typeof d.colA === "string" && typeof d.colB === "string"){
    setColours(d.colA, d.colB);

    if(!colADirty && document.activeElement !== el("colA")) el("colA").value = d.colA;
    if(!colBDirty && document.activeElement !== el("colB")) el("colB").value = d.colB;
  }

  if(d.dur !== undefined){
    const mins = Math.round(Number(d.dur) / 60);
    if(Number.isFinite(mins) && !minsDirty && document.activeElement !== el("mins")){
      el("mins").value = mins;
    }
  }

  if(d.bp !== undefined && d.bv !== undefined){
    const bp = Number(d.bp);
    const bv = Number(d.bv);
    if(Number.isFinite(bp) && Number.isFinite(bv)){
      el("batt").textContent = Math.round(bp) + "% / " + bv.toFixed(2) + "V";
    }
  }

  const finished = d.winner === "TEAM_A" || d.winner === "TEAM_B" || d.winner === "DRAW";

  el("startBtn").disabled = !!d.started || !!d.lowBatt;
  el("pauseBtn").disabled = !d.started || !!d.paused || finished;
  el("resumeBtn").disabled = !d.started || !d.paused || !!d.lowBatt || finished;
  el("resetBtn").disabled = !(!!d.paused || finished);

  let stateLabel = (d.started ? "Started" : "Stopped") + (d.paused ? " / Paused" : "");
  if(d.recovery) stateLabel += " / Recovery saved";
  el("stateText").textContent = stateLabel;
  updateCards(d);
  updateStatus(d);
}

function connectWs(){
  if(!wsWanted) return;
  try{
    ws = new WebSocket("ws://" + location.hostname + ":81/");
  }catch(e){
    setTimeout(connectWs, 1500);
    return;
  }

  ws.onopen = function(){ setConn("Live", true); };
  ws.onmessage = function(ev){
    try{ updateUI(JSON.parse(ev.data)); }catch(e){}
  };
  ws.onerror = function(){ try{ ws.close(); }catch(e){} };
  ws.onclose = function(){
    setConn("Retrying", false);
    setTimeout(connectWs, 1500);
  };
}

function pollState(){
  fetch("/state", {cache:"no-store"})
    .then(r => r.json())
    .then(d => {
      updateUI(d);
      if(!ws || ws.readyState !== 1) setConn("Polling", true);
    })
    .catch(() => {
      if(Date.now() - lastStateAt > 3000) setConn("Offline", false);
    });
}

function cmd(c){
  fetch("/cmd?c=" + encodeURIComponent(c), {cache:"no-store"})
    .then(() => setTimeout(pollState, 120))
    .catch(() => {});
}

function applyDuration(){
  let m = parseInt(el("mins").value || "5", 10);
  if(!Number.isFinite(m)) m = 5;
  if(m < 1) m = 1;
  if(m > 60) m = 60;
  el("mins").value = m;
  fetch("/set?dur=" + encodeURIComponent(m), {cache:"no-store"})
    .then(() => {
      minsDirty = false;
      setTimeout(pollState, 120);
    })
    .catch(() => {});
}

function applyColors(){
  const a = el("colA").value;
  const b = el("colB").value;
  fetch("/set?colA=" + encodeURIComponent(a) + "&colB=" + encodeURIComponent(b), {cache:"no-store"})
    .then(() => {
      colADirty = false;
      colBDirty = false;
      setTimeout(pollState, 120);
    })
    .catch(() => {});
}

function quickSet(s){
  el("adjSecs").value = s;
}

function getAdjustSeconds(){
  let s = parseInt(el("adjSecs").value || "30", 10);
  if(!Number.isFinite(s)) s = 30;
  if(s < 1) s = 1;
  if(s > 600) s = 600;
  el("adjSecs").value = s;
  return s;
}

function adjustTime(team, delta){  fetch("/adjust?team=" + encodeURIComponent(team) + "&delta=" + encodeURIComponent(delta), {cache:"no-store"})
    .then(() => setTimeout(pollState, 120))
    .catch(() => {});
}

connectWs();
pollState();
setInterval(pollState, 1000);
</script>
</body>
</html>
)HTML";

static void handleSydneyNerfLogo() {
  server.sendHeader("Cache-Control", "public, max-age=86400");
  server.send_P(
    200,
    "image/webp",
    (const char*)SYDNEY_NERF_LOGO_WEBP,
    sizeof(SYDNEY_NERF_LOGO_WEBP)
  );
}

static void handlePCBWayLogo() {
  server.sendHeader("Cache-Control", "public, max-age=86400");
  server.send_P(
    200,
    "image/webp",
    (const char*)PCBWAY_LOGO_WEBP,
    sizeof(PCBWAY_LOGO_WEBP)
  );
}

static void sendNoCacheHeaders() {
  server.sendHeader("Cache-Control", "no-store, no-cache, must-revalidate, max-age=0");
  server.sendHeader("Pragma", "no-cache");
  server.sendHeader("Expires", "0");
}

static void handleRoot(){
  sendNoCacheHeaders();
  server.send_P(200, "text/html", INDEX_HTML);
}

static void handleConfig(){
  String json;
  json.reserve(96);
  json = "{";
  json += "\"dur\":" + String(durationSec) + ",";
  json += "\"colA\":\"" + colorA + "\",";
  json += "\"colB\":\"" + colorB + "\"}";

  sendNoCacheHeaders();
  server.send(200, "application/json", json);
}

static void handleNotFound(){
  sendNoCacheHeaders();
  server.send(
    404,
    "text/plain",
    "Not found. Join KOTH-Timer Wi-Fi and open http://10.10.10.1/"
  );
}

static void handlePing(){
  server.sendHeader("Cache-Control", "no-store");
  server.send(200, "text/plain", "KOTH Timer OK");
}

static void handleState(){
  sendNoCacheHeaders();
  server.send(200, "application/json", makeStateJson());
}

static void handleSet(){
  if(server.hasArg("dur")){
    int mins = server.arg("dur").toInt();
    if(mins < 1) mins = 1;
    if(mins > 60) mins = 60;
    durationSec = (uint32_t)mins * 60;
  }
  if(server.hasArg("colA")){
    String requested = server.arg("colA");
    if(!isValidHtmlColor(requested)){
      server.send(400, "text/plain", "Invalid Team A colour");
      return;
    }
    colorA = requested;
  }

  if(server.hasArg("colB")){
    String requested = server.arg("colB");
    if(!isValidHtmlColor(requested)){
      server.send(400, "text/plain", "Invalid Team B colour");
      return;
    }
    colorB = requested;
  }

  saveConfig();
  if(!started) {
    clearRecoveryState();
    resetTimers();
    rearmVictorySound();
  }
  server.send(200, "text/plain", "OK");
}

static void handleCmd(){
  String c = server.arg("c");

  if(c=="start"){
    if(!started && !lowBatteryCritical){
      manualStartSequenceActive = false;
      manualStartMatchStarted = false;
      bothButtonsHeldSinceMs = 0;

      clearRecoveryState();
      rearmVictorySound();
      started = true;
      paused  = false;
      lastTickMs = millis();
    }
  }
  else if(c=="pause"){
    if(started && !paused){
      paused = true;
    }
  }
  else if(c=="resume"){
    // A critical battery can never be manually overridden. After a battery
    // swap/reboot, the recovered match remains paused until this command.
    if(started && paused && !lowBatteryCritical){
      paused = false;
      clearRecoveryState();
      lastTickMs = millis();
    }
  }
  else if(c=="reset"){
    // Only allow reset if paused OR match finished
    if(paused || remainingA <= 0 || remainingB <= 0){
      manualStartSequenceActive = false;
      manualStartMatchStarted = false;
      bothButtonsHeldSinceMs = 0;

      resetTimers();
      clearRecoveryState();
      rearmVictorySound();
      started = false;
      paused  = false;
    }
  }
  else if(c=="identify" && !started){
    identifyMode = true;
    identifyUntilMs = millis() + 5000;
  }

  server.send(200, "text/plain", "OK");
}

static void handleAdjust(){
  if(!server.hasArg("team") || !server.hasArg("delta")){
    server.send(400, "text/plain", "Missing team or delta");
    return;
  }

  String team = server.arg("team");
  int32_t delta = server.arg("delta").toInt();

  // Safety clamp: one click/request can only adjust by up to 10 minutes.
  if(delta > 600) delta = 600;
  if(delta < -600) delta = -600;

  if(team != "A" && team != "B"){
    server.send(400, "text/plain", "Invalid team");
    return;
  }

  adjustTeamTime(team, delta);

  // If the admin corrects a battery-recovered game before resuming it,
  // update the emergency snapshot so another power interruption still
  // restores the corrected scores.
  if(recoverySnapshotValid && started && paused &&
     remainingA > 0 && remainingB > 0){
    saveRecoveryState();
  }

  // If time was added back after a match finished, normal loop logic will
  // leave DONE state on the next capture-state evaluation.
  broadcastState();

  server.send(200, "text/plain", "OK");
}

static void onWsEvent(uint8_t num, WStype_t type, uint8_t*, size_t){
  if(type == WStype_CONNECTED){
    String p = makeStateJson();
    ws.sendTXT(num, p);
  }
}

static void registerWebRoutes() {
  server.on("/", handleRoot);
  server.on("/config", handleConfig);
  server.on("/set", handleSet);
  server.on("/cmd", handleCmd);
  server.on("/adjust", handleAdjust);
  server.on("/ping", handlePing);
  server.on("/state", handleState);
  server.on("/sydney-nerf.webp", handleSydneyNerfLogo);
  server.on("/pcbway.webp", handlePCBWayLogo);
  server.onNotFound(handleNotFound);
}

static void startAdminWiFi(){
  WiFi.persistent(false);
  WiFi.mode(WIFI_OFF);
  delay(150);

  WiFi.mode(WIFI_AP);
  WiFi.setSleep(false);
  WiFi.setTxPower(WIFI_POWER_19_5dBm);

  bool configOK = WiFi.softAPConfig(AP_IP, AP_GATEWAY, AP_SUBNET);

  const char* pass = nullptr;
  if(strlen(AP_PASS) >= 8){
    pass = AP_PASS;
  }

  bool apOK = WiFi.softAP(
    AP_SSID,
    pass,
    AP_CHANNEL,
    AP_HIDDEN,
    AP_MAX_CLIENTS
  );

  delay(150);

  Serial.println();
  Serial.println("===== KOTH Timer Wi-Fi =====");
  Serial.print("Firmware: ");
  Serial.println(FIRMWARE_VERSION);
  Serial.print("AP config: ");
  Serial.println(configOK ? "OK" : "FAILED");
  Serial.print("AP started: ");
  Serial.println(apOK ? "YES" : "NO");
  Serial.print("SSID: ");
  Serial.println(AP_SSID);
  Serial.print("Admin page: http://");
  Serial.print(WiFi.softAPIP());
  Serial.println("/");
  if(strlen(AP_PASS) >= 8){
    Serial.print("Password: ");
    Serial.println(AP_PASS);
  } else {
    Serial.println("Password: open network");
  }
  Serial.println("============================");
}

//// ===== Setup/Loop =====
void setup(){
  Serial.begin(115200);
  delay(50);

  pinMode(PIN_BTN_A, INPUT_PULLUP);
  pinMode(PIN_BTN_B, INPUT_PULLUP);
  pinMode(PIN_BTN_BAT, INPUT_PULLUP);

  pinMode(PIN_LED_A, OUTPUT);
  pinMode(PIN_LED_B, OUTPUT);
  digitalWrite(PIN_LED_A, LOW);
  digitalWrite(PIN_LED_B, LOW);

  pinMode(PIN_BUZZER, OUTPUT);
  stopBuzzer();

  pinMode(PIN_BAR_RED, OUTPUT);
  pinMode(PIN_BAR_YELLOW, OUTPUT);
  pinMode(PIN_BAR_G1, OUTPUT);
  pinMode(PIN_BAR_G2, OUTPUT);
  pinMode(PIN_BAR_G3, OUTPUT);
  barAllOff();

  pinMode(PIN_BATT_ADC, INPUT);
  analogReadResolution(12);
  analogSetPinAttenuation(PIN_BATT_ADC, ADC_11db);

  loadConfig();
  resetTimers();

  // If the previous battery hit the critical threshold during a live match,
  // restore that exact game state but keep it frozen until the admin resumes.
  loadRecoveryState();

  dispA1.setBrightness(7, true);
  dispA2.setBrightness(7, true);
  dispB1.setBrightness(7, true);
  dispB2.setBrightness(7, true);
  updateDisplays();

  registerWebRoutes();
  startAdminWiFi();

  server.begin();

  ws.begin();
  ws.onEvent(onWsEvent);

  // Initialise battery filter with a first reading so it doesn't ramp from 0
  battVoltsRaw = readBattVoltsInstant();
  battVolts = battVoltsRaw;
  battPct = voltsToPct(battVolts);
  lowBatteryCritical = (battVoltsRaw < LOW_BATT_ENTER_V);
  lowBattLowCount = 0;
  lowBattHighCount = 0;

  lastTickMs = millis();
  lastBroadcastMs = 0;
}

void loop(){
  server.handleClient();
  ws.loop();

  const uint32_t now = millis();

  // ---- Non-blocking buzzer update ----
  // This runs before Identify mode because Identify returns early from loop().
  updateBuzzer(now);

  // ---- Smooth battery update ----
  static uint32_t lastBattMs = 0;
  if(now - lastBattMs >= BATT_UPDATE_MS){
    battVoltsRaw = readBattVoltsInstant();
    battVolts = battVolts + EMA_ALPHA * (battVoltsRaw - battVolts); // EMA smoothing
    battPct = voltsToPct(battVolts);

    // Protection uses the averaged INSTANT reading rather than the slow EMA.
    // EMA_ALPHA=0.05 is excellent for a stable UI, but using it for protection
    // could delay a real low-battery freeze by many seconds.
    if (!lowBatteryCritical) {
      if (battVoltsRaw < LOW_BATT_ENTER_V) {
        if (lowBattLowCount < LOW_BATT_CONFIRM_SAMPLES) lowBattLowCount++;
      } else {
        lowBattLowCount = 0;
      }

      if (lowBattLowCount >= LOW_BATT_CONFIRM_SAMPLES) {
        lowBatteryCritical = true;
        lowBattLowCount = 0;
        lowBattHighCount = 0;

        // Emergency action: stop game time and persist the current state.
        freezeAndSaveForLowBattery();
      }

    } else {
      if (battVoltsRaw > LOW_BATT_EXIT_V) {
        if (lowBattHighCount < LOW_BATT_CONFIRM_SAMPLES) lowBattHighCount++;
      } else {
        lowBattHighCount = 0;
      }

      if (lowBattHighCount >= LOW_BATT_CONFIRM_SAMPLES) {
        lowBatteryCritical = false;
        lowBattLowCount = 0;
        lowBattHighCount = 0;

        // Deliberately DO NOT auto-resume. The admin controls the restart.
      }
    }

    lastBattMs = now;
  }

  // ---- Battery bar button ----
  readDebounced(btnBt);
  static bool lastBat = false;
  bool batNow = isPressed(btnBt);
  if(batNow && !lastBat) triggerBarShow();
  lastBat = batNow;

  if(barActive){
    barShowBars(voltsToBars(battVolts), battVolts, now);
    if((int32_t)(now - barOffAtMs) >= 0){
      barActive = false;
      barAllOff();
    }
  } else {
    barAllOff();
  }

  // ---- Identify mode (stopped only): flash displays + LEDs ----
  if(identifyMode){
    if((int32_t)(now - identifyUntilMs) >= 0){
      identifyMode = false;
      dispA1.clear(); dispA2.clear(); dispB1.clear(); dispB2.clear();
      digitalWrite(PIN_LED_A, LOW);
      digitalWrite(PIN_LED_B, LOW);
    } else {
      bool blink = (now / 400) % 2;

      if(blink){
        dispA1.showNumberDec(1111, false);
        dispA2.showNumberDec(1111, false);
        dispB1.showNumberDec(2222, false);
        dispB2.showNumberDec(2222, false);
        digitalWrite(PIN_LED_A, HIGH);
        digitalWrite(PIN_LED_B, HIGH);
      } else {
        dispA1.clear(); dispA2.clear(); dispB1.clear(); dispB2.clear();
        digitalWrite(PIN_LED_A, LOW);
        digitalWrite(PIN_LED_B, LOW);
      }

      // keep UI live
      if(now - lastBroadcastMs >= 500){
        broadcastState();
        lastBroadcastMs = now;
      }
      return; // skip normal game logic during identify
    }
  }

  // ---- Read team buttons ----
  readDebounced(btnA);
  readDebounced(btnB);

  bool aHeld = isPressed(btnA);
  bool bHeld = isPressed(btnB);

  // ---- Manual physical start: hold BOTH team buttons for 5 seconds ----
  //
  // This is deliberately available only while the match is fully stopped.
  // A paused/recovered game cannot accidentally be replaced by a new match.
  if(!started && !manualStartSequenceActive && !lowBatteryCritical){
    if(aHeld && bHeld){
      if(bothButtonsHeldSinceMs == 0){
        bothButtonsHeldSinceMs = now;
      } else if(now - bothButtonsHeldSinceMs >= MANUAL_START_HOLD_MS){
        manualStartSequenceActive = true;
        manualStartMatchStarted = false;
        manualStartSequenceStartedMs = now;
        bothButtonsHeldSinceMs = 0;

        // A physical start is a deliberate new game start.
        clearRecoveryState();
        victoryPlayed = false;
        startManualStartCountdown();
      }
    } else {
      // Releasing either button before 5 seconds cancels the hold.
      bothButtonsHeldSinceMs = 0;
    }
  } else if(started || lowBatteryCritical){
    bothButtonsHeldSinceMs = 0;
  }

  // If the battery becomes critical during the audible countdown, abort it.
  if(manualStartSequenceActive && lowBatteryCritical){
    manualStartSequenceActive = false;
    manualStartMatchStarted = false;
    bothButtonsHeldSinceMs = 0;

    if(buzzerMode == BUZZER_MANUAL_START){
      stopBuzzer();
    }
  }

  // GO occurs at the beginning of the long third beep.
  if(manualStartSequenceActive &&
     !manualStartMatchStarted &&
     !lowBatteryCritical &&
     now - manualStartSequenceStartedMs >= MANUAL_START_GO_MS){

    started = true;
    paused = false;
    manualStartMatchStarted = true;
    lastTickMs = now;
  }

  // ---- Evaluate capture state ----
  evaluateCaptureState(aHeld, bHeld);

  // ---- Arcade button LED logic ----
  if(!started){
    digitalWrite(PIN_LED_A, LOW);
    digitalWrite(PIN_LED_B, LOW);
  } else if(captureState == ST_A){
    digitalWrite(PIN_LED_A, HIGH);
    digitalWrite(PIN_LED_B, LOW);
  } else if(captureState == ST_B){
    digitalWrite(PIN_LED_A, LOW);
    digitalWrite(PIN_LED_B, HIGH);
  } else if(captureState == ST_CONTESTED){
    digitalWrite(PIN_LED_A, HIGH);
    digitalWrite(PIN_LED_B, HIGH);
  } else {
    digitalWrite(PIN_LED_A, LOW);
    digitalWrite(PIN_LED_B, LOW);
  }

  // ---- Countdown tick ----
  uint32_t elapsedMs = now - lastTickMs;
  lastTickMs = now;

  if(started && !paused && captureState == ST_A){
    partialMsA += elapsedMs;

    while(partialMsA >= 1000UL && remainingA > 0){
      partialMsA -= 1000UL;
      remainingA--;

      if(remainingA == 0){
        partialMsA = 0;
        startVictoryChime();
      } else {
        startScoreChirp();
      }
    }
  }
  else if(started && !paused && captureState == ST_B){
    partialMsB += elapsedMs;

    while(partialMsB >= 1000UL && remainingB > 0){
      partialMsB -= 1000UL;
      remainingB--;

      if(remainingB == 0){
        partialMsB = 0;
        startVictoryChime();
      } else {
        startScoreChirp();
      }
    }
  }

  // ---- Update display ----
  // Gameplay is still whole-second MM:SS. 50 ms refresh is used so the
  // non-blocking winner spinner looks smooth without affecting timer accuracy.
  static uint32_t lastDispMs = 0;
  if(now - lastDispMs >= 50){
    updateDisplays();
    lastDispMs = now;
  }

  // ---- Broadcast to UI ----
  if(now - lastBroadcastMs >= 500){
    broadcastState();
    lastBroadcastMs = now;
  }

  delay(1);
}